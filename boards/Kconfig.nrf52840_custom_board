## boards/Kconfig.nrf52840_custom_board
```kconfig
# Copyright (c) 2022 Zephyr Project members and individual contributors
# SPDX-License-Identifier: Apache-2.0

config BOARD_NRF52840_CUSTOM_BOARD
	select SOC_NRF52840_QIAA
```

## boards/board.yml
```yaml
board:
  name: nrf52840_custom_board
  full_name: nRF52840_custom_board
  vendor: nordic
  socs:
  - name: nrf52840
```
