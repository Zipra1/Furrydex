## boards/nrf52840_custom_board_defconfig
```kconfig
# SPDX-License-Identifier: Apache-2.0

# supermini stuff
CONFIG_BUILD_OUTPUT_UF2=y
CONFIG_FLASH_LOAD_OFFSET=0x1000

# board specific
CONFIG_FURRYDEX_EPD_WIDTH=128
CONFIG_FURRYDEX_EPD_HEIGHT=250

CONFIG_FURRYDEX_EPD_MAX_BYTES=4125
CONFIG_FURRYDEX_CURSOR_START_X=0
CONFIG_FURRYDEX_CURSOR_START_Y=249
```

## boards/promicro/Kconfig.promicro
```kconfig
# Copyright (c) 2022 Zephyr Project members and individual contributors
# SPDX-License-Identifier: Apache-2.0

config BOARD_PROMICRO
	select SOC_NRF52840_QIAA
```

## boards/promicro/board.yml
```yaml
board:
  name: promicro
  full_name: promicro
  vendor: nordic
  socs:
  - name: nrf52840
```
